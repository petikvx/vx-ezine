PATH          DB 'PATH='
PATH_LEN      EQU $-PATH
HOME_LINE     DB 0DH,'$'
PURE_LINE     DB 78 DUP (0H)
              DB '$'
DRIVE         DB ?
COM_MASK      DB '*.COM',0H
CPATH         DB MAXLEN_PATH DUP (?)
              DB 0H
KOSAYA        DB '\',0H
INFECT_MEMORY db 0h   ;Проверка памяти на заражение резидентным вирусом
Ok_Byte       db 0h   ;Ok для чистых файлов
Mode          db 0h   ;Режим поиск/лечение
Mode_Mem_Test db 0h   ;проверять/не проверять память
DOG_INFECTION db 0h   ;Проверка на зараженность собственного кода
INFECT_FILE   db 0h   ;Проверка на зараженность текущего файла
FILE_TIME     dw ?    ;Время создания тестируемого файла
FILE_DATE     dw ?    ;Дата создания тестируемого файла
HANDLE        dw ?    ;Описатель файла
FILE_ATTRIB   dw ?    ;Атрибуты файла
PROTOKOL      db 0h   ;Печать протокола в файл DOG.RPT
;----------------------
HEADER_VIRUS  db 0h   ;Вирус в начале/в конце файла
CRYPTO_VIRUS  db 0h   ;Тело вируса зашифровано
OVERWRITE_VIR db 0h   ;Вирус пишет свой код поверх программного
CRYPTO_FILE   db 0h   ;Вирус шифрует тело заражаемых программ
COM_EXE_FILE  db 0h   ;Обрабатывается COM /EXE файл
SPECIAL_PROC  dw ?    ;Номер процедуры специальной обработки вируса (0-нет)
TSR_VIRUS     db ?    ;резидент/не резидент
;----------------------
SIGNATURE_VIR db 10 dup (?) ;Сигнатура вируса
SIGNATURE_LEN db ?          ;Длина сигнатуры для поиска
BEGIN_LENGTH  db ?          ;Длина начальных байт программы
BEGIN_OFFSET  dw ?          ;Смещение начальных байт/заголовка относит. сигн.
BEGIN_SWITH   db ?          ;добавлять/вычитать смещ. начала к смещ. сигн.
LENGTH_0      db ?          ;0-длина идет подряд, 1-длина в разных местах
LENGTH_1      db ?          ;Длина первой части длины программы
LENGTH_2      db ?          ;Длина второй части длины программы
LENGTH_OFFS_1 dw ?          ;Смещение первой части длины программы
LENGTH_OFFS_2 dw ?          ;Смещение второй части длины программы
LENGTH_SWITH1 db ?          ;добавлять/вычитать смещение первой части длины
LENGTH_SWITH2 db ?          ;добавлять/вычитать смещение второй части длины
;---------------------
FILE_SEGMENT  dw ?    ;Адрес сегмента тестируемого файла
SIGNATURE_OFF dw ?    ;Смещение сигнатуры относительно начала сегмента
;---------------------
FNAME         db 12 dup (?) ;Имя тестируемого файла
              db 0h         ;Нулевой символ
EXE_MASK      db '*.exe',0h ;Маска для поиска EXE программ
;---------------------
VIR_NAME_OFFS dw ?          ;Смещение имени вируса в таблице
INFORM_OFFS   dw ?          ;Смещение информации о вирусе в таблице
;---------------------

;----------------------------------------------------------------
INFORMATIONS db 0ah,0dh,0ah,0dh,'┌──────────────────────┐  <──────────────────────>  ┌──────────────────╖'
             db 0ah,0dh,        '│Антивирусная программа│  <  Версия от 16.02.96  >  │██████████████████║'
             db 0ah,0dh,        '│░▒▓█    ^/───\^    █▓▒░  <      48 вирусов      >  │██████████████████║'
             db 0ah,0dh,        '│░▒▓█   /  °.°  \   █▓▒░  <──────────────────────>  │████████▒▒████████║'
             db 0ah,0dh,        '│░▒▓█  │ ┌┬┬┬┬┬┐ │  █▓▒░ .·∙∙∙∙∙∙∙∙∙∙∙∙∙∙∙∙∙∙∙∙∙∙·. │██████▒▒▒▒▒▒██████║'
             db 0ah,0dh,        '│░▒▓█   \ D O G /   █▓▒░ Дикшев Игорь Владиславович │████████▒▒████████║'
             db 0ah,0dh,        '│░▒▓█    └┴┴┴┴┴┘    █▓▒░ .·∙∙∙∙∙∙∙∙∙∙∙∙∙∙∙∙∙∙∙∙∙∙·. │██████████████████║'
             db 0ah,0dh,        '│(c) Copyright 1993,96 │      Тел. 0872-331258      │██████████████████║'
             db 0ah,0dh,        '└──────────────────────┘      Факс 0872-331305      ╘══════════════════╝'
             db 0ah,0dh,0ah,0dh,'$'

TEST_MEM_MSG DB 'Проверка памяти компьютера на наличие вирусов','$'

TEST_MEM_OKM DB 'В памяти компьютера вирусы не обнаружены.',0ah,0dh,0ah,0dh,'$'

EN_ER        DB 0AH,0DH,'$'

PROMPT_REBOOT db 0ah,0dh,07h,07h,07h
              db 'Программа DOG инфицирована неизвестным вирусом!'
              db 0ah,0dh
              db 'Просьба передать её в кратчайшие сроки автору.'
              db 0ah,0dh,0ah,0dh
              db 'А сейчас предлагаю произвести перезагрузку системы, для предотвращения'
              db 0ah,0dh
              db 'дальнейшего заражения файлов и предупреждения возможных деструктивных'
              db 0ah,0dh
              db 'воздействий со стороны вируса. Произвести перезагрузку [Y] ?','$'

BUSSER        db 07h,'$'

Ok_Message   db 0ah,0dh,'Известные автору вирусы не обнаружены!',0ah,0dh,'$'

Message_Re   db 0ah,0dh,'Возможно пришлось несовсем корректно модифицировать память компьютера.'
             db 0ah,0dh,'Для нормальной работы необходимо произвести перезагрузку.'
             db 0ah,0dh,'Перезагрузить систему [Y] ?','$'

Er_Message   db 0ah,0dh,'Диск закрыт для записи! Снимите защиту и повторите тестирование.',0ah,0dh,'$'
ERROR_FILE    db ' - не открывается!','$'

FILE_MSG     db 0ah,0dh,'Файл ','$'
INFECTED     db ' - инфицирован вирусом ','$'
CURED_MSG    db ' - обезврежен!','$'
KILLED_MSG   db ' - удален!','$'
Some_MSG     db ' - возможно инфицирован вирусом ','$'
Ok           db ' - Здоров!','$'
OWR_MSG      db ' - испорчен вирусом ','$'
NO_CURE      db 0ah,0dh,'Вылечить невозможно! Удалить этот файл [Y] ?','$'
TSR_MSG_VIR  db 0ah,0dh,'В памяти обнаружен вирус ','$'

USER_ABORT   db 0ah,0dh,0ah,0dh,'Прерывание работы пользователем!',0ah,0dh,'$'

WARNING_MSG  db 0ah,0dh,'Для лечения файлов, запустите программу DOG с ключем /F','$'

WAR_MES      db 0ah,0dh,'Благодарности принимаются круглосуточно! :)',0ah,0dh,'$'

Lozinsky_MSG db 0ah,0dh,'Вылечить не могу! В данном случае рекомендую использовать AIDSTEST.','$'
Daniloff_MSG db 0ah,0dh,'Вылечить не могу! В данном случае рекомендую использовать DrWEB.','$'
Kaspersk_MSG db 0ah,0dh,'Вылечить не могу! В данном случае рекомендую использовать AVP.','$'
Diksheff_MSG db 0ah,0dh,'Вылечить не могу! Передайте Дикшеву Игорю этот файл для изучения модификации.','$'

MSG_1_REP    db 0ah,0dh,'Проверено файлов    ','$'
MSG_2_REP    db 0ah,0dh,'Найдено вирусов     ','$'
MSG_3_REP    db 0ah,0dh,'Обезврежено вирусов ','$'
MSG_4_REP    db 0ah,0dh,'Удалено файлов      ','$'
