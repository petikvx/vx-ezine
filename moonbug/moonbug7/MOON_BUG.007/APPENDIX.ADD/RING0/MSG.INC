
db 13,10
db "   &&&&&&&&&&&&                   %&,    %&\                 __  ^$$$^^^^$$",13,10
db '   ^""""""&$$&~                  ]$$$    $$$    ________    ]$$[  $$$',13,10
db '        %$$"        _,,,,,_      &$$$[  &$$$[   ]$$$^^^$$$  __,_  $$$$$$$[',13,10
db "      ,$$&        ,$$$&&&&$$\   _$$&$$ ]$$$$&    $$[   ]$$' ^$$[  $$$",13,10
db "     &$$'        &$&'     ^$$   &$& $$$$$' $$    $$$%%$$$_   $$[  $$$     %",13,10
db "   ,$$&         {$$        $$[ ]$$' ]$$$&  $$&   $$[`  ^$$$  $$[ <$$$$%%%$$",13,10
db "   $$$$$$$$$$$$ $$[       ,$$  !$$   $$$   ]$$   $$[    $$$ )$$$",13,10
db "                !$$_     %$$'   ~           ""  {$$$%%%$$$'",13,10
db "                '&$$&&&$$&'",13,10
db '                   ~"""~',13,10
db '          _______   ____    ______  .______ __    _, ______ ,_____',13,10
db "          ]$````^ ,$^^`^$\  [$``^$$  $'```^ `$_   $  $[```^  $^``^$",13,10
db "          ]$%%%$  $'     $$ [$__,$^  $%%%$   ]$  $'  $$%%%'  $___%$",13,10
db "          ]$   `  $[     $[ [$`^$\   $'       $[][   $[      $^^$$",13,10
db "          ]$      ^\$\,<$^  [$  `$$ _$\,,,<'  ^$$    $$,,,%[_$_  $$_",13,10
db 13,10
db '                                 Release 3.00',13,10
db 13,10
db '             Thanx for great help to S.S.R., LordASD, <no name>',13,10
db 13,10
db '    Greetings to VLAD, 29A, N0P, Zhengxi, Nutcracker, SoulManager, JQwerty,',13,10
db '                           GriYo, MrSandman, Darkman...',13,10
db 13,10
db '             HomePage: www.chat.ru/~z0mbie, E-Mail: z0mbie@chat.ru',13,10
db 13,10
