DES_tables:

PC1_C0   db 57,49,41,33,25,17,09
         db 01,58,50,42,34,26,18
         db 10,02,59,51,43,35,27
         db 19,11,03,60,52,44,36

PC1_D0   db 63,55,47,39,31,23,15
         db 07,62,54,46,38,30,22
         db 14,06,61,53,45,37,29
         db 21,13,05,28,20,12,04

SHIFT    db 1,1,2,2,2,2,2,2,1,2,2,2,2,2,2,1

PC2      db 14,17,11,24,01,05
         db 03,28,15,06,21,10
         db 23,19,12,04,26,08
         db 16,07,27,20,13,02
         db 41,52,31,37,47,55
         db 30,40,51,45,33,48
         db 44,49,39,56,34,53
         db 46,42,50,36,29,32

IP       db 58,50,42,34,26,18,10,02
         db 60,52,44,36,28,20,12,04
         db 62,54,46,38,30,22,14,06
         db 64,56,48,40,32,24,16,08
         db 57,49,41,33,25,17,09,01
         db 59,51,43,35,27,19,11,03
         db 61,53,45,37,29,21,13,05
         db 63,55,47,39,31,23,15,07

IPT      db 40,08,48,16,56,24,64,32
         db 39,07,47,15,55,23,63,31
         db 38,06,46,14,54,22,62,30
         db 37,05,45,13,53,21,61,29
         db 36,04,44,12,52,20,60,28
         db 35,03,43,11,51,19,59,27
         db 34,02,42,10,50,18,58,26
         db 33,01,41,09,49,17,57,25

E        db 32,01,02,03,04,05
         db 04,05,06,07,08,09
         db 08,09,10,11,12,13
         db 12,13,14,15,16,17
         db 16,17,18,19,20,21
         db 20,21,22,23,24,25
         db 24,25,26,27,28,29
         db 28,29,30,31,32,01

S1       db 14,04,13,01,02,15,11,08,03,10,06,12,05,09,00,07
         db 00,15,07,04,14,02,13,01,10,06,12,11,09,05,03,08
         db 04,01,14,08,13,06,02,11,15,12,09,07,03,10,05,00
         db 15,12,08,02,04,09,01,07,05,11,03,14,10,00,06,13

S2       db 15,01,08,14,06,11,03,04,09,07,02,13,12,00,05,10
         db 03,13,04,07,15,02,08,14,12,00,01,10,06,09,11,05
         db 00,14,07,11,10,04,13,01,05,08,12,06,09,03,02,15
         db 13,08,10,01,03,15,04,02,11,06,07,12,00,05,14,09

S3       db 10,00,09,14,06,03,15,05,01,13,12,07,11,04,02,08
         db 13,07,00,09,03,04,06,10,02,08,05,14,12,11,15,01
         db 13,06,04,09,08,15,03,00,11,01,02,12,05,10,14,07
         db 01,10,13,00,06,09,08,07,04,15,14,03,11,05,02,12

S4       db 07,13,14,03,00,06,09,10,01,02,08,05,11,12,04,15
         db 13,08,11,05,06,15,00,03,04,07,02,12,01,10,14,09
         db 10,06,09,00,12,11,07,13,15,01,03,14,05,02,08,04
         db 13,15,00,06,10,01,13,08,09,04,05,11,12,07,02,14

S5       db 02,12,04,01,07,10,11,06,08,05,03,15,13,00,14,09
         db 14,11,02,12,04,07,13,01,05,00,15,10,03,08,09,06
         db 04,02,01,11,10,13,07,08,15,09,12,05,06,03,00,14
         db 11,08,12,07,01,14,02,13,06,15,00,09,10,04,05,03

S6       db 12,01,10,15,09,02,06,08,00,13,03,04,14,07,05,11
         db 10,15,04,02,07,12,09,05,06,01,13,14,00,11,03,08
         db 09,14,15,05,02,08,12,03,07,00,04,10,01,13,11,06
         db 04,03,02,12,09,05,15,10,11,14,01,04,06,00,08,13

S7       db 04,11,02,14,15,00,08,13,03,12,09,07,05,10,06,01
         db 13,00,11,07,04,09,01,10,14,03,05,12,02,15,08,06
         db 01,04,11,13,12,03,07,14,10,15,06,08,00,05,09,02
         db 06,11,13,08,01,04,10,07,09,05,00,15,14,02,03,12

S8       db 13,02,08,04,06,15,11,01,10,09,03,14,05,00,12,07
         db 01,15,13,08,10,03,07,04,12,05,06,11,00,14,09,02
         db 07,11,04,01,09,12,14,02,00,06,10,13,15,03,05,08
         db 02,01,14,07,04,10,08,13,15,12,09,00,03,05,06,11

P        db 16,07,20,21,29,12,28,17
         db 01,05,23,26,05,18,31,10
         db 02,08,24,14,32,27,03,09
         db 19,13,30,06,22,11,04,25
