;===================================================================
;  Dynamic Huffman compress/decompress library
;  size is 345 + 394 + 79 bytes
;===================================================================
huffman_init:
		db 060h,08Bh,0ECh,0B9h,000h,00Ah,000h,000h,02Bh,0E1h
		db 08Dh,0BDh,000h,0F6h,0FFh,0FFh,033h,0C0h,057h,0F3h
		db 0AAh,05Ah,08Bh,0C2h,033h,0C9h,066h,089h,008h,083h
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		db 03Bh,0CBh,075h,0AEh,061h,0C3h
huffman_compress:
		db 060h,08Bh,0ECh,0B9h,023h,023h,000h,000h,02Bh,0E1h
		db 033h,0C0h,08Dh,0BDh,0DDh,0DCh,0FFh,0FFh,0F3h,0AAh
		db 08Dh,095h,0DDh,0DCh,0FFh,0FFh,08Bh,05Dh,030h,08Bh
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		db 044h,024h,01Ch,061h,0C3h
huffman_decompress:
		db 060h,08Bh,0ECh,08Bh,075h,028h,08Bh,07Dh,02Ch,08Bh
		db 055h,034h,033h,0C0h,057h,08Bh,05Dh,030h,00Ah,0E4h
		db 075h,003h,0ACh,0B4h,008h,08Bh,0FBh,06Bh,0FFh,006h
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		db 02Bh,07Dh,02Ch,089h,07Ch,024h,01Ch,061h,0C3h