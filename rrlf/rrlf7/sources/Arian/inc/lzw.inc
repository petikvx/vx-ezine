; By using this file, you agree to the terms and conditions set
; forth in the COPYING file which can be found at the top level
; of this distribution.
;
;------------------------------------------------------------------------------
; Warning this file is automatically generated!
; Size is 529 bytes
global lzw_compress, lzw_expand

lzw_compress:
db	0x60,0xfc,0x8b,0x6c,0x24,0x30,0x89,0x65,0x10,0x8b,0x44,0x24,0x28,0x89,0x45,0x04
db	0x31,0xc0,0x89,0x45,0x00,0xb9,0x79,0x46,0x00,0x00,0x8d,0xbd,0x7f,0xd3,0x00,0x00
db	0x48,0xf3,0x66,0xab,0x8b,0x74,0x24,0x24,0xc7,0x45,0x08,0x00,0x01,0x00,0x00,0x31
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db	0xd3,0x89,0x4c,0x24,0x1c,0x61,0xc2,0x08,0x00
lzw_expand:
db	0x60,0xfc,0x8b,0x74,0x24,0x24,0x8b,0x7c,0x24,0x28,0x8b,0x6c,0x24,0x2c,0x89,0x75
db	0x04,0x31,0xc0,0x89,0x45,0x00,0xc7,0x45,0x08,0x00,0x01,0x00,0x00,0xe8,0x67,0x00
db	0x00,0x00,0x89,0xc1,0x89,0xc3,0xaa,0xe8,0x5d,0x00,0x00,0x00,0x89,0xc6,0x66,0x3d
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db	0x89,0x4c,0x24,0x1c,0x61,0xc2,0x08,0x00
