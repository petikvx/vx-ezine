; By using this file, you agree to the terms and conditions set
; forth in the COPYING file which can be found at the top level
; of this distribution.
;
;------------------------------------------------------------------------------
; Warning this file is automatically generated!
; Size is 782 bytes
global ari_compress, ari_expand

ari_compress:
db	0x60,0xfc,0x8b,0x74,0x24,0x24,0x8b,0x44,0x24,0x28,0x8b,0x4c,0x24,0x2c,0x8b,0x6c
db	0x24,0x30,0x89,0x65,0x18,0x89,0x4d,0x14,0x89,0x45,0x10,0x31,0xc0,0x89,0x45,0x0c
db	0xe8,0x18,0x01,0x00,0x00,0xe8,0xd4,0x00,0x00,0x00,0x8d,0x5d,0x1c,0x31,0xc0,0xac
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db	0xc3
ari_expand:
db	0x60,0xfc,0x8b,0x44,0x24,0x24,0x8b,0x7c,0x24,0x28,0x8b,0x6c,0x24,0x2c,0x89,0x45
db	0x10,0x31,0xc0,0x89,0x45,0x0c,0x8d,0xb5,0x1c,0x04,0x00,0x00,0xe8,0x6b,0x00,0x00
db	0x00,0xe8,0x37,0x00,0x00,0x00,0xe8,0x89,0x01,0x00,0x00,0x89,0xc3,0x3d,0x01,0x01
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db	0x0f,0x73,0x01,0x40,0xff,0x45,0x0c,0x89,0x44,0x24,0x1c,0x61,0xc3
